## arch/riscv/configs/litex_linux_defconfig
```kconfig
CONFIG_MACH_LITEX=y
CONFIG_BUILTIN_DTB=y
CONFIG_BUILTIN_DTB_NAME="litex-linux"
CONFIG_TEXT_BASE=0x44000000
CONFIG_MEMORY_LAYOUT_FIXED=y
CONFIG_STACK_BASE=0x440e0000
CONFIG_STACK_SIZE=0x20000
CONFIG_MALLOC_BASE=0x44100000
CONFIG_MALLOC_SIZE=0xf00000
CONFIG_MALLOC_TLSF=y
CONFIG_PANIC_HANG=y
CONFIG_BAUDRATE=1000000
CONFIG_HUSH_FANCY_PROMPT=y
CONFIG_CMDLINE_EDITING=y
CONFIG_AUTO_COMPLETE=y
# CONFIG_TIMESTAMP is not set
CONFIG_BOOTM_SHOW_TYPE=y
CONFIG_BOOTM_VERBOSE=y
CONFIG_BOOTM_INITRD=y
CONFIG_BOOTM_OFTREE=y
CONFIG_BOOTM_OFTREE_UIMAGE=y
CONFIG_DEFAULT_ENVIRONMENT_GENERIC_NEW=y
CONFIG_DEFAULT_ENVIRONMENT_PATH="arch/riscv/mach-litex/env/"
CONFIG_POLLER=y
CONFIG_DEBUG_LL=y
CONFIG_LONGHELP=y
CONFIG_CMD_IOMEM=y
CONFIG_CMD_IMD=y
CONFIG_CMD_MEMINFO=y
CONFIG_CMD_GO=y
CONFIG_CMD_LOADY=y
CONFIG_CMD_EXPORT=y
CONFIG_CMD_CMP=y
CONFIG_CMD_MD5SUM=y
CONFIG_CMD_SHA1SUM=y
CONFIG_CMD_MSLEEP=y
CONFIG_CMD_SLEEP=y
CONFIG_CMD_DHCP=y
CONFIG_CMD_MIITOOL=y
CONFIG_CMD_PING=y
CONFIG_CMD_TFTP=y
CONFIG_CMD_ECHO_E=y
CONFIG_CMD_EDIT=y
CONFIG_CMD_MEMTEST=y
CONFIG_CMD_MM=y
CONFIG_CMD_CLK=y
CONFIG_CMD_GPIO=y
CONFIG_CMD_SPI=y
CONFIG_CMD_OF_DUMP=y
CONFIG_CMD_TIME=y
CONFIG_CMD_DHRYSTONE=y
CONFIG_NET=y
CONFIG_NET_NFS=y
CONFIG_NET_NETCONSOLE=y
CONFIG_OFDEVICE=y
CONFIG_DRIVER_NET_LITEETH=y
CONFIG_AR8327N_PHY=y
CONFIG_AT803X_PHY=y
CONFIG_DAVICOM_PHY=y
CONFIG_DP83867_PHY=y
CONFIG_LXT_PHY=y
CONFIG_MARVELL_PHY=y
CONFIG_MICREL_PHY=y
CONFIG_NATIONAL_PHY=y
CONFIG_REALTEK_PHY=y
CONFIG_SMSC_PHY=y
CONFIG_NET_DSA_MV88E6XXX=y
CONFIG_DRIVER_SPI_LITEX_SPIFLASH=y
CONFIG_MTD=y
# CONFIG_MTD_OOB_DEVICE is not set
CONFIG_MTD_M25P80=y
CONFIG_CLOCKSOURCE_DUMMY_RATE=20000
CONFIG_CLOCKSOURCE_LITEX_TIMER0=y
CONFIG_SRAM=y
CONFIG_GPIO_GENERIC_PLATFORM=y
# CONFIG_PINCTRL is not set
CONFIG_FS_TFTP=y
CONFIG_FS_NFS=y
CONFIG_DIGEST_CRC32_GENERIC=y
```

## arch/riscv/mach-litex/Kconfig
```kconfig
if MACH_LITEX

choice
	prompt "Board type"

config BOARD_LITEX_GENERIC
	bool "litex generic board"

endchoice

endif
```
